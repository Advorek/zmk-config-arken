#include "arkenswoop.dtsi"

&kscan0 {
    // Jeśli to klawiatura typu "split direct pin" lub ma dedykowany offset kolumn
};

// Konfiguracja ekranu OLED na lewej połówce (Piny I2C: zwykle SDA=SDA, SCL=SCL)
&pro_micro_i2c {
    status = "okay";

    oled: ssd1306@3c {
        compatible = "solomon,ssd1306fb";
        reg = <0x3c>;
        label = "DISPLAY";
        width = <128>;
        height = <32>;
        segment-remap;
        com-invdir;
        com-hw-config;
        multiplex-ratio = <31>;
        prechargep = <0x22>;
        page-offset = <0>;
        display-offset = <0>;
        segment-offset = <0>; // Ten parametr jest wymagany przez kompilator
    };
};
