## config/boards/shields/arkenswoop/Kconfig.defconfig
```kconfig
if SHIELD_ARKENSWOOP_LEFT || SHIELD_ARKENSWOOP_RIGHT

config ZMK_KEYBOARD_NAME
    default "Arkenswoop"

config ZMK_SPLIT
    default y

endif
```
